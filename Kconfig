## Kconfig
```kconfig
config TOTEM_STUDIO_PROFILES
    bool "TOTEM profiles selected through ZMK Studio"
    default y if ZMK_STUDIO && (SHIELD_TOTEM_LEFT || SHIELD_TOTEM_DONGLE)
    depends on ZMK_STUDIO
    depends on !ZMK_SPLIT || ZMK_SPLIT_ROLE_CENTRAL
```

## dts/bindings/behaviors/roosmsg,profile-to.yaml
```yaml
description: Switch layer while retaining the selected TOTEM typing profile
compatible: "roosmsg,profile-to"
include: one_param.yaml
```
